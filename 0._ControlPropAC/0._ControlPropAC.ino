//Librerías, objetos y varialbes para SD
#include <SPI.h>
#include <SD.h>
const int chipSelect = 10; //Pin de selección de la SD

//Librerías, objetos y variables para RTC
#include <Wire.h>
#include "RTClib.h"
RTC_DS1307 rtc;    //Se declara un objeto RTC

//Librerías, objetos y varialbes para el monitoreo
#include "DHT.h"
#include "EmonLib.h"
DHT senInt(2, DHT22); //Sensor de temperatura interna (Pin digital, Tipo de DHT)
DHT senExt(3, DHT11); //Sensor de temperatura externa
EnergyMonitor velectric;        // Se declara un objeto Energy Monitor
double ip = 30, is = 0.015, rburden = 120; //Datos para la calibración del sensor de corriente
float humInt = 0.0;       //Variable Humedad interna
float tempInt = 0.0;      //variable Temperatura interna
float humExt = 0.0;       //Variable Humedad externa
float tempExt = 0.0;      //Variable Temperatura externa
float Vrms = 0.0;         //Variable Voltaje RMS
float Irms = 0.0;         //Variable Corriente RMS
int lastMin = 0;         //Tiempo de guardado inicial
int minNow = 0;          //Tiempo de guardado actual
int storageTime = 1;      //Tiempo de espera para guardar en minutos (máximo 60 minutos)
int lastHour = 0;         //Tiempo de control inicial
int hourNow = 0;          //Tiempo de control actual
int controlTime = 1;      //Tiempo de espera para realizar control en horas (máximo 23 horas)

//Librerías, objetos y variables para el controlador:
#include <IRremote.h>
IRsend actuadorIR;      //Objeto para transmitir los comandos IR al AC
int carrierFcy = 38;    //Frecuencia portadora para la transmisión IR
//Códigos IR AC Intervenido
unsigned int ir17[] =  {4332, 4472, 552,  1636, 544,  552,  548,  1640, 548,  1636, 548,  552,  544,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  1644, 504};
unsigned int ir18[] =  {4412, 4388, 552,  1632, 552,  592,  504,  1656, 532,  1636, 552,  588,  508,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  1640, 548};
unsigned int ir19[] =  {4416, 4400, 552,  1632, 552,  572,  524,  1636, 552,  1636, 548,  592,  504,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  1640, 548};
unsigned int ir20[] =  {4488, 4376, 568,  1564, 612,  544,  564,  1616, 568,  1620, 568,  540,  560,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  1568, 528};
unsigned int ir21[] =  {4392, 4408, 472,  1628, 556,  628,  464,  1696, 496,  1716, 468,  604,  468,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  1708, 476};
unsigned int ir22[] =  {4504, 4296, 476,  1660, 524,  624,  572,  1612, 572,  1612, 576,  476,  620,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  1504, 688};
unsigned int ir23[] =  {4456, 4388, 504,  1680, 480,  632,  488,  1688, 504,  1680, 480,  632,  488,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  1688, 476};
unsigned int ir24[] =  {4576, 4292, 576,  1560, 684,  476,  624,  1504, 680,  1504, 680,  464,  636,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  1608, 500};
//unsigned int ir25[] =  {4484, 4332, 612,  1572, 608,  544,  556,  1628, 500,  1632, 616,  544,  464,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  1548, 644};
//unsigned int ir26[] =  {4488, 4352, 528,  1632, 552,  608,  492,  1636, 552,  1684, 500,  596,  500,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  1620, 476};
//unsigned int ir27[] =  {4488, 4376, 504,  1680, 564,  548,  552,  1572, 552,  1684, 568,  532,  568,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  1568, 528};
//unsigned int ir28[] =  {4512, 4364, 472,  1708, 476,  620,  564,  1576, 524,  1664, 524,  632,  556,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  1664, 524};
//unsigned int ir29[] =  {4440, 4320, 620,  1616, 568,  536,  564,  1568, 620,  1624, 560,  532,  564,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  1616, 480};
//unsigned int ir30[] =  {4516, 4312, 520,  1708, 504,  596,  572,  1612, 572,  1572, 544,  596,  576,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  1504, 684};
//unsigned int irOn[] =  {4508, 4292, 644,  1496, 684,  460,  640,  1552, 636,  1496, 688,  456,  640,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  1548, 640};
//unsigned int irOff[] = {4332, 4480, 536,  1560, 624,  560,  464,  1636, 556,  1716, 468,  632,  464,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  1696, 468};

void setup() {

  SD.begin(chipSelect, 11, 12, 13);

  rtc.begin();

  //    rtc.adjust(DateTime(F(__DATE__), F(__TIME__))); //Ajusta la fecha y la hora del RTC


  //Calibración del sensor de corriente y voltaje
  double calibration = ((ip / is) / rburden);
  velectric.current(0, calibration);                 //Corriente: (Pin de lectura, Calibración)
  velectric.voltage(1, 112, 1.7);                    //Voltaje: (Pin de lectura, calibración, Desfase)
  //Fin calibración del sensor de corriente y voltaje
}

void loop() {

  energy();
  climate();
  timer();
}

//Función para el alamacenamiento de los datos del monitoreo:
void storage() {

  DateTime now = rtc.now();

  File dataFile = SD.open("Mon1.txt", FILE_WRITE);

  // Escribiendo en la SD:

  if (dataFile) {

    //1. Imprimir la fecha y la hora:

    dataFile.print(now.year(), DEC);
    dataFile.print('/');
    dataFile.print(now.month(), DEC);
    dataFile.print('/');
    dataFile.print(now.day(), DEC);
    dataFile.print("  ");
    dataFile.print(now.hour(), DEC);
    dataFile.print(':');
    dataFile.print(now.minute(), DEC);
    dataFile.print(':');
    dataFile.print(now.second(), DEC);
    dataFile.print("  ");

    //2. Imprimir los valores del monitoreo:

    dataFile.print(humInt);
    dataFile.print("  ");
    dataFile.print(tempInt);
    dataFile.print("  ");
    dataFile.print(humExt);
    dataFile.print("  ");
    dataFile.print(tempExt);
    dataFile.print("  ");
    dataFile.print(Vrms);
    dataFile.print("  ");
    dataFile.println(Irms);

    //3. Cerrar el archivo en la SD para evitar pérdida de información

    dataFile.close();
  }
}

//Función para el monitoreo de la corriente y el voltaje:
void energy() {
  for (int i = 0; i >= 5; i++) {
    velectric.calcVI(50000000, 1000);        // Calcula corriente y voltaje
  }
  velectric.calcVI(50000000, 2000);
  Vrms = velectric.Vrms;
  Irms = velectric.Irms;
}

//Función para el monitoreo de la temperatura interna y externa:
void climate() {

  humInt = senInt.readHumidity();
  tempInt = senInt.readTemperature();

  humExt = senExt.readHumidity();
  tempExt = senExt.readTemperature();

}

//Función para guardar datos cada cierto tiempo:
void timer() {

  DateTime now = rtc.now();
  minNow = now.minute();
  hourNow = now.hour();
  //Definición de tiempo para guardar monitoreo
  if (minNow - lastMin >= storageTime) {
    storage();
    lastMin = minNow;
  }
  if (minNow - lastMin < 0) {
    lastMin = -1;
  }
  //Definición de tiempo para realizar control
  if (hourNow - lastHour >= controlTime) {
    control();
    lastHour = hourNow;
  }
  if (hourNow - lastHour < 0) {
    lastHour = -1;
  }
}

//Función para aplicar control al AC. El control de esta función no es PID.
void control () {
  if (Irms >= 1.8) {
    //double spIc = -0.0228*(pow(tempExt, 2)) + 1.6647*(tempExt) - 2.8486;     //Ecuación polinómica a partir de los promedios
    double spIc = 0.146954358259569 * tempExt + 22.1773101681836;             //Ecuación de la regresión Lineal
    float spIr1 = (round(spIc * 10)) / 10.0;
    int spIr2 = round(spIr1);
    int spIn = map(spIr2, 15, 30, 7, 27);                                         //Set Point Ideal normalizado.

    switch (spIn) {
      case (17): {
          actuadorIR.sendRaw(ir17, sizeof(ir17) / sizeof(ir17[0]), carrierFcy);
          break;
        }
      case (18): {
          actuadorIR.sendRaw(ir18, sizeof(ir18) / sizeof(ir18[0]), carrierFcy);
          break;
        }
      case (19): {
          actuadorIR.sendRaw(ir19, sizeof(ir19) / sizeof(ir19[0]), carrierFcy);
          break;
        }
      case (20): {
          actuadorIR.sendRaw(ir20, sizeof(ir20) / sizeof(ir20[0]), carrierFcy);
          break;
        }
      case (21): {
          actuadorIR.sendRaw(ir21, sizeof(ir21) / sizeof(ir21[0]), carrierFcy);
          break;
        }
      case (22): {
          actuadorIR.sendRaw(ir22, sizeof(ir22) / sizeof(ir22[0]), carrierFcy);
          break;
        }
      case (23): {
          actuadorIR.sendRaw(ir23, sizeof(ir23) / sizeof(ir23[0]), carrierFcy);
          break;
        }
      case (24): {
          actuadorIR.sendRaw(ir24, sizeof(ir24) / sizeof(ir24[0]), carrierFcy);
          break;
        }
    }
  }
}
